## conf/layer.conf
```bitbake
# We have a conf and classes directory, add to BBPATH
BBPATH .= ":${LAYERDIR}"

# We have recipes-* directories, add to BBFILES
BBFILES += "${LAYERDIR}/recipes-*/*/*.bb \
            ${LAYERDIR}/recipes-*/*/*.bbappend"

BBFILE_COLLECTIONS += "meta-tx2-jp43-j120"
BBFILE_PATTERN_meta-tx2-jp43-j120 = "^${LAYERDIR}/"
BBFILE_PRIORITY_meta-tx2-jp43-j120 = "6"

LAYERDEPENDS_meta-tx2-jp43-j120 = "core"
LAYERSERIES_COMPAT_meta-tx2-jp43-j120 = "dunfell"
```
